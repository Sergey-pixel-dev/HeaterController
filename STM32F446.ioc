# file: STM32F446.ioc
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Mcu.Family=STM32F4
Mcu.Name=STM32F446R(C-E)Tx
Mcu.Package=LQFP64
NVIC.PriorityGroup=NVIC_PRIORITYGROUP_4
PA13.Mode=Serial_Wire
PA13.Signal=SYS_JTMS-SWDIO
PA14.Mode=Serial_Wire
PA14.Signal=SYS_JTCK-SWCLK
PH0-OSC_IN.Mode=HSE-External-Oscillator
PH0-OSC_IN.Signal=RCC_OSC_IN
PH1-OSC_OUT.Mode=HSE-External-Oscillator
PH1-OSC_OUT.Signal=RCC_OSC_OUT
ProjectManager.HeapSize=0x200
ProjectManager.StackSize=0x400
ProjectManager.TargetToolchain=CMake
RCC.AHBFreq_Value=180000000
RCC.APB1CLKDivider=RCC_HCLK_DIV4
RCC.APB1Freq_Value=45000000
RCC.APB1TimFreq_Value=90000000
RCC.APB2CLKDivider=RCC_HCLK_DIV2
RCC.APB2Freq_Value=90000000
RCC.APB2TimFreq_Value=180000000
RCC.CortexFreq_Value=180000000
RCC.HCLKFreq_Value=180000000
RCC.PLLM=8
RCC.PLLN=180
RCC.SYSCLKFreq_VALUE=180000000
RCC.SYSCLKSource=RCC_SYSCLKSOURCE_PLLCLK
RCC.USBFreq_Value=180000000
RCC.VCOOutputFreq_Value=360000000
board=custom

// file: Core/Src/main.c
/* USER CODE BEGIN Header */
/**
 ******************************************************************************
 * @file           : main.c
 * @brief          : Main program body
 ******************************************************************************
 * @attention
 *
 * Copyright (c) 2025 STMicroelectronics.
 * All rights reserved.
 *
 * This software is licensed under terms that can be found in the LICENSE file
 * in the root directory of this software component.
 * If no LICENSE file comes with this software, it is provided AS-IS.
 *
 ******************************************************************************
 */
/* USER CODE END Header */
#include "main.h"
#include "eeprom.h"
#include "i2c.h"
#include "init.h"
#include "modbusSlave.h"
#include "stm32f4xx_hal.h"

/* USER CODE BEGIN PM */
#define VREFINT_CAL_ADDR 0x1FFF7A2A
/* USER CODE END PM */

/* USER CODE BEGIN PV */
uint16_t vdda = 3300;
uint8_t RxBufferUART5[UART5_TX_BUF_SIZE];
uint8_t TxBufferUART5[UART5_TX_BUF_SIZE];
uint16_t SizeRxBuf = 0;
uint8_t uart5_tx_dma_busy = 0;
uint8_t uart4_tx_dma_busy = 0;

volatile uint8_t modbus_uart5_pending = 0;
volatile uint8_t modbus_uart4_pending = 0;
volatile uint8_t eeprom_write_modbus_req_count_pending = 0;
volatile uint8_t eeprom_write_coef_pending = 0;

volatile ModbusState_t modbus_state = MODBUS_IDLE;
volatile uint16_t SizeRxBufUART4 = 0;
uint8_t RxBufferUART4[UART4_RX_BUF_SIZE];
uint8_t TxBufferUART4[UART4_TX_BUF_SIZE];

uint16_t c_a[N_SEGMENTS];
uint16_t c_b[N_SEGMENTS];
uint16_t c_d[N_SEGMENTS];
uint16_t c_e[N_SEGMENTS];
uint16_t c_index = 0;
uint16_t delta_u;
uint16_t i_set_cur;

uint32_t last_tick = 0;
uint32_t last_tick_second = 0;

uint8_t buf1[256];
uint8_t buf2[256];

// Статистика
uint32_t modbus_req_count = 0;
uint32_t work_time = 0;
uint8_t log_count = 0;
uint8_t log_i = 0;

EEPROM_t eeprom = {0x50, 256, 8, 1, 32, I2C_MEMADD_SIZE_8BIT};

uint8_t NormalOrKZ = 0; // 0 - 1 Ом, 1 - КЗ

/* USER CODE END PV */

void SystemClock_Config(void);
static void MX_GPIO_Init(void);
/* USER CODE BEGIN PFP */
void DAC_Init(void);
void DAC_SetVoltage(uint16_t voltage);
void DAC_StartChangingV(void);
void ADC_Init(void);
void MeasureVref(void);
uint16_t ADC_ReadChannel(uint8_t channel);

void DMA_Init(void);

void UART_Init(void);

void MODBUS_Timer_Init(void);

void Calibration(void);
void Set_I(uint16_t i);
void Change_I(void);

void TIM6_Init(void);
uint16_t Get_c_a_by_I(uint16_t i);
uint16_t Get_c_b_by_U_mes(uint16_t u);
uint16_t Get_c_d_by_U(uint16_t u);
uint16_t Get_c_e_by_I(uint16_t i);
void WriteLog(LogType_t type, uint8_t subtype, uint8_t code);
/* USER CODE END PFP */

int main(void)
{

    /* MCU Configuration--------------------------------------------------------*/

    /* Reset of all peripherals, Initializes the Flash interface and the Systick. */
    HAL_Init();

    /* Configure the system clock */
    SystemClock_Config();

    /* Initialize all configured peripherals */
    MX_GPIO_Init();
    /* USER CODE BEGIN 2 */
    ADC_Init();
    ADC1->CR2 |= ADC_CR2_ADON;
    DAC_Init();
    DAC->CR |= DAC_CR_EN1;
    DMA_Init();
    UART_Init();
    MODBUS_Timer_Init();
    TIM6_Init();
    I2C1_Init(I2C_SPEED_STANDARD);
    DMA1_Stream0->CR |= DMA_SxCR_EN;
    MeasureVref();

    usRegHoldingBuf[HREG_OPERATING_I] = 6000;  // Рабочий ток
    usRegHoldingBuf[HREG_STANDBY_I] = 3000;    // Ток ожидания
    usRegHoldingBuf[HREG_CURRENT_SPEED] = 200; // Скорость нарастания
    usRegHoldingBuf[HREG_ACCURACY] = 50;       // Точность

    usCoilsBuf[0] = 0;
    SET_STANDBY_MODE();
    SET_JMPR_STATUS();

    usDiscreteBuf[0] = 0;

    Coils_ApplyToPins();
    last_tick = HAL_GetTick();
    last_tick_second = HAL_GetTick();
    // Структура хранения. [] - это 1 байт. Наименее значимый байт хранится по меньшему адресу.
    // [кол-во коэф.] (сначала c_a) [Младший байт коэф. 1][Старший байт коэф. 1][Младший байт коэф. 2][Старший
    // байт коэф. 2]...
    // ...[Младший байт коэф. 15][Старший байт коэф. 15](потом c_b) [Младший байт коэф. 1][Старший байт коэф.
    // 1][Младший байт коэф. 2][Старший байт коэф. 2]...
    // ... [Младший байт коэф. 15][Старший байт коэф. 15]..... []...[] - 7 байтов для выравнивания
    // --- 128 БАЙТА ЗАПИСАНЫ ---
    // Далее идут 8 байта статистики, пока запишем так:
    // [время работы][время работы][время работы][время работы](4 байта времени работы в сек.)
    // [кол-во модбас обращений][кол-во модбас обращений][кол-во модбас обращений][кол-во модбас обращений]
    // --- 136 БАЙТОВ ЗАПИСАНЫ ---
    // Сначала 1 байт хранит кол-во записей в данной сессии (ВСЕ ЗАПИСИ ОЧИЩАЮТСЯ ПЕРЕД НОВЫМ ЗАПУСКОМ)
    // [кол-во записей]
    // Далее идут байты записи (5 байт), структура записи:
    // [байт тик][байт тик][байт тик][байт тик](32-битный тик с момента запуска контролллера)
    // [AA, BB, CCCC], где AA 01 - INFO, 10 - WARNING, 11 - ERROR. BB - код раздела (типа для разделения), CCCC
    // - код записи. для 256 x 8 eeprom кол-во записей макс - 25.
    /* USER CODE END 2 */

    /* Infinite loop */
    /* USER CODE BEGIN WHILE */
    // Очищаем записи

    // Очищаем записи лога (адреса 136-255)
    EEPROM_Write(&eeprom, EEPROM_ADDR_LOG_COUNT, buf1, 120, 100);

    // Читаем кол-во коэф. с памяти
    uint8_t c_c = 0;
    EEPROM_Read(&eeprom, EEPROM_ADDR_COEF_COUNT, &c_c, 1, 10);

    if (c_c == N_SEGMENTS) {
        uint8_t c_a_8[2 * N_SEGMENTS];
        uint8_t c_b_8[2 * N_SEGMENTS];
        uint8_t c_d_8[2 * N_SEGMENTS];
        uint8_t c_e_8[2 * N_SEGMENTS];

        EEPROM_Read(&eeprom, EEPROM_ADDR_C_A, c_a_8, 2 * N_SEGMENTS, 100);
        EEPROM_Read(&eeprom, EEPROM_ADDR_C_B, c_b_8, 2 * N_SEGMENTS, 100);
        EEPROM_Read(&eeprom, EEPROM_ADDR_C_D, c_d_8, 2 * N_SEGMENTS, 100);
        EEPROM_Read(&eeprom, EEPROM_ADDR_C_E, c_e_8, 2 * N_SEGMENTS, 100);

        for (uint8_t i = 0; i < N_SEGMENTS; i++) {
            c_a[i] = c_a_8[2 * i] | (c_a_8[2 * i + 1] << 8);
            if (c_a[i] > EEPROM_COEF_MAX_VALUE)
                c_a[i] = COEF_A_DEFAULT << Q11_SHIFT;

            c_b[i] = c_b_8[2 * i] | (c_b_8[2 * i + 1] << 8);
            if (c_b[i] > EEPROM_COEF_MAX_VALUE)
                c_b[i] = COEF_B_DEFAULT << Q11_SHIFT;

            c_d[i] = c_d_8[2 * i] | (c_d_8[2 * i + 1] << 8);
            if (c_d[i] > EEPROM_COEF_MAX_VALUE)
                c_d[i] = COEF_D_DEFAULT << Q11_SHIFT;

            c_e[i] = c_e_8[2 * i] | (c_e_8[2 * i + 1] << 8);
            if (c_e[i] > EEPROM_COEF_MAX_VALUE)
                c_e[i] = COEF_E_DEFAULT;
        }
    }

    // Читаем статистику с памяти
    uint8_t work_time_8[4];
    EEPROM_Read(&eeprom, EEPROM_ADDR_WORK_TIME, work_time_8, 4, 100);
    work_time = work_time_8[0] | (work_time_8[1] << 8) | (work_time_8[2] << 16) | (work_time_8[3] << 24);

    uint8_t modbus_req_count_8[4];
    EEPROM_Read(&eeprom, EEPROM_ADDR_MODBUS_CNT, modbus_req_count_8, 4, 100);
    modbus_req_count = modbus_req_count_8[0] | (modbus_req_count_8[1] << 8) | (modbus_req_count_8[2] << 16) |
                       (modbus_req_count_8[3] << 24);

    while (1) {

        /* USER CODE END WHILE */

        /* USER CODE BEGIN 3 */
        // Deferred EEPROM write for MODBUS statistics
        if (eeprom_write_modbus_req_count_pending) {
            eeprom_write_modbus_req_count_pending = 0;
            uint8_t modbus_req_count_8[4] = {modbus_req_count & 0x000000FF, (modbus_req_count >> 8) & 0xFF,
                                             (modbus_req_count >> 16) & 0xFF, (modbus_req_count >> 24) & 0xFF};
            EEPROM_Write(&eeprom, EEPROM_ADDR_MODBUS_CNT, modbus_req_count_8, 4, 100);
        }
        if (eeprom_write_coef_pending) {
            eeprom_write_coef_pending = 0;
            uint8_t c_c = N_SEGMENTS;
            uint8_t c_a_8[2 * N_SEGMENTS];
            uint8_t c_b_8[2 * N_SEGMENTS];
            uint8_t c_d_8[2 * N_SEGMENTS];
            uint8_t c_e_8[2 * N_SEGMENTS];

            for (uint8_t i = 0; i < N_SEGMENTS; i++) {
                c_a_8[2 * i] = c_a[i] & 0xFF;
                c_a_8[2 * i + 1] = (c_a[i] >> 8) & 0xFF;
                c_b_8[2 * i] = c_b[i] & 0xFF;
                c_b_8[2 * i + 1] = (c_b[i] >> 8) & 0xFF;
                c_d_8[2 * i] = c_d[i] & 0xFF;
                c_d_8[2 * i + 1] = (c_d[i] >> 8) & 0xFF;
                c_e_8[2 * i] = c_e[i] & 0xFF;
                c_e_8[2 * i + 1] = (c_e[i] >> 8) & 0xFF;
            }

            EEPROM_Write(&eeprom, EEPROM_ADDR_COEF_COUNT, &c_c, 1, 100);
            EEPROM_Write(&eeprom, EEPROM_ADDR_C_A, c_a_8, 2 * N_SEGMENTS, 100);
            EEPROM_Write(&eeprom, EEPROM_ADDR_C_B, c_b_8, 2 * N_SEGMENTS, 100);
            EEPROM_Write(&eeprom, EEPROM_ADDR_C_D, c_d_8, 2 * N_SEGMENTS, 100);
            EEPROM_Write(&eeprom, EEPROM_ADDR_C_E, c_e_8, 2 * N_SEGMENTS, 100);
        }

        uint32_t current_tick = HAL_GetTick();
        if (current_tick - last_tick >= LOOP_UPDATE_PERIOD_MS) {
            last_tick = current_tick;

            MeasureVref();
            uint8_t jumper_state = (JUMPER_GPIO->IDR & (1 << JUMPER_PIN)) ? 1 : 0;
            if (jumper_state != CHECK_JMPR_STATUS()) {
                if (jumper_state)
                    SET_JMPR_STATUS();
                else
                    CLR_JMPR_STATUS();
            }

            uint16_t u_current_mes = ADC_ReadChannel(ADC_CH_CURRENT_MES);
            uint16_t I_cur = Calculate_I_from_U(u_current_mes);

            usRegInputBuf[IREG_I_CURRENT] = I_cur;
            usRegInputBuf[IREG_U_CURRENT_MES] = u_current_mes;

            // U_выхода = u_adc * K_u - I * K_i
            uint16_t u_adc_raw = ADC_ReadChannel(ADC_CH_VOLTAGE_MES);
            uint16_t K_u = Get_c_d_by_U(u_adc_raw);
            uint16_t K_i = Get_c_e_by_I(I_cur);

            uint32_t term1 = ((uint32_t)u_adc_raw * K_u + Q11_HALF) >> Q11_SHIFT;
            uint32_t term2 = ((uint32_t)I_cur * K_i + Q11_HALF) >> Q11_SHIFT;

            usRegInputBuf[IREG_U_MES] = (term1 >= term2) ? (uint16_t)(term1 - term2) : 0;

            uint16_t heater_adc = ADC_ReadChannel(ADC_CH_HEATER_CHECK);
            usRegInputBuf[IREG_HEATER_ADC] = heater_adc;

            uint16_t heater_ref = usRegHoldingBuf[HREG_HEATER_LEVEL];
            uint16_t heater_low = (heater_ref >= 100) ? (heater_ref - 100) : 0;
            if (heater_adc >= heater_low && heater_adc <= 3300)
                SET_HEATER_STATUS();
            else
                CLR_HEATER_STATUS();

            uint16_t u_27v = ADC_ReadChannel(ADC_CH_27V);
            uint16_t u_12v = ADC_ReadChannel(ADC_CH_12V);
            uint16_t u_m5v = ADC_ReadChannel(ADC_CH_M5V);

            usRegInputBuf[IREG_27V] = u_27v;
            usRegInputBuf[IREG_12V] = u_12v;
            usRegInputBuf[IREG_M5V] = u_m5v;

            uint16_t ref_27v = usRegHoldingBuf[HREG_27V];
            uint16_t ref_12v = usRegHoldingBuf[HREG_12V];
            uint16_t ref_m5v = usRegHoldingBuf[HREG_M5V];

            if (ABS_DIFF(u_27v, ref_27v) > 20) {
                if (!CHECK_ERROR_27V())

                    WriteLog(ERR, 1, 1);
                SET_ERROR_27V();

            } else
                CLR_ERROR_27V();

            if (ABS_DIFF(u_12v, ref_12v) > 20) {
                if (!CHECK_ERROR_12V())
                    WriteLog(ERR, 1, 2);
                SET_ERROR_12V();

            } else
                CLR_ERROR_12V();

            if (ABS_DIFF(u_m5v, ref_m5v) > 20) {
                if (!CHECK_ERROR_M5V())

                    WriteLog(ERR, 1, 3);
                SET_ERROR_M5V();

            } else
                CLR_ERROR_M5V();

            if (!CHECK_CUR_SETTING() && !CHECK_CALIB_IN_PR()) {
                uint16_t I_setpoint;
                if (CHECK_SET_OPERATING_MODE())
                    I_setpoint = usRegHoldingBuf[HREG_OPERATING_I];
                else
                    I_setpoint = usRegHoldingBuf[HREG_STANDBY_I];
                if (ABS_DIFF(I_cur, I_setpoint) > usRegHoldingBuf[HREG_ACCURACY]) {
                    Set_I(I_setpoint);
                }
            }
        }
        if (current_tick - last_tick_second >= 1000) {
            work_time++;
            uint8_t work_time_8[4] = {work_time & 0x000000FF, work_time & 0x0000FF00, work_time & 0x00FF0000,
                                      work_time & 0xFF000000};
            // EEPROM_Write(&eeprom, 64, work_time_8, 4, 100);
            last_tick_second = current_tick;
            // MeasureVref();
        }
    }
    /* USER CODE END 3 */
}

void SystemClock_Config(void)
{
    RCC_OscInitTypeDef RCC_OscInitStruct = {0};
    RCC_ClkInitTypeDef RCC_ClkInitStruct = {0};

    /** Configure the main internal regulator output voltage
     */
    __HAL_RCC_PWR_CLK_ENABLE();
    __HAL_PWR_VOLTAGESCALING_CONFIG(PWR_REGULATOR_VOLTAGE_SCALE1);

    /** Initializes the RCC Oscillators according to the specified parameters
     * in the RCC_OscInitTypeDef structure.
     */
    RCC_OscInitStruct.OscillatorType = RCC_OSCILLATORTYPE_HSI;
    RCC_OscInitStruct.HSIState = RCC_HSI_ON;
    RCC_OscInitStruct.HSICalibrationValue = RCC_HSICALIBRATION_DEFAULT;
    RCC_OscInitStruct.PLL.PLLState = RCC_PLL_ON;
    RCC_OscInitStruct.PLL.PLLSource = RCC_PLLSOURCE_HSI;
    RCC_OscInitStruct.PLL.PLLM = 8;
    RCC_OscInitStruct.PLL.PLLN = 180;
    RCC_OscInitStruct.PLL.PLLP = RCC_PLLP_DIV2;
    RCC_OscInitStruct.PLL.PLLQ = 2;
    RCC_OscInitStruct.PLL.PLLR = 2;
    if (HAL_RCC_OscConfig(&RCC_OscInitStruct) != HAL_OK) {
        Error_Handler();
    }

    /** Activate the Over-Drive mode
     */
    if (HAL_PWREx_EnableOverDrive() != HAL_OK) {
        Error_Handler();
    }

    /** Initializes the CPU, AHB and APB buses clocks
     */
    RCC_ClkInitStruct.ClockType = RCC_CLOCKTYPE_HCLK | RCC_CLOCKTYPE_SYSCLK | RCC_CLOCKTYPE_PCLK1 | RCC_CLOCKTYPE_PCLK2;
    RCC_ClkInitStruct.SYSCLKSource = RCC_SYSCLKSOURCE_PLLCLK;
    RCC_ClkInitStruct.AHBCLKDivider = RCC_SYSCLK_DIV1;
    RCC_ClkInitStruct.APB1CLKDivider = RCC_HCLK_DIV4;
    RCC_ClkInitStruct.APB2CLKDivider = RCC_HCLK_DIV2;

    if (HAL_RCC_ClockConfig(&RCC_ClkInitStruct, FLASH_LATENCY_5) != HAL_OK) {
        Error_Handler();
    }
}

static void MX_GPIO_Init(void)
{

    /* GPIO Ports Clock Enable */
    __HAL_RCC_GPIOH_CLK_ENABLE();
    __HAL_RCC_GPIOA_CLK_ENABLE();

    /* USER CODE BEGIN MX_GPIO_Init_2 */
    GPIO_Init();
    /* USER CODE END MX_GPIO_Init_2 */
}

/* USER CODE BEGIN 4 */
void DAC_SetVoltage(uint16_t voltage)
{
    uint16_t dac_value = (((uint32_t)voltage << 12) / vdda) & 0xFFF;
    DAC->DHR12R1 = dac_value > 0xFFF ? 0xFFF : dac_value;
    DAC->SWTRIGR |= DAC_SWTRIGR_SWTRIG1;
}
void DAC_ChangeVoltage(void)
{
    if (DAC->DHR12R1 > usRegHoldingBuf[HREG_CALIB_VALUE])
        DAC->DHR12R1 -= 1;
    else if (DAC->DHR12R1 < usRegHoldingBuf[HREG_CALIB_VALUE])
        DAC->DHR12R1 += 1;
    else {
        CLR_CUR_SETTING();
        // Остановка TIM6
        TIM6->CR1 &= ~TIM_CR1_CEN;
        TIM6->CNT = 0;
        return;
    }
    usRegInputBuf[IREG_U_SET] = ((uint32_t)DAC->DHR12R1 * vdda) / 0xFFF;
    DAC->SWTRIGR |= DAC_SWTRIGR_SWTRIG1;
}
void DAC_StartChangingV(void)
{
    if (CHECK_CALIB_IN_PR() && !CHECK_CUR_SETTING()) {
        SET_CUR_SETTING();
        // Запуск TIM6
        TIM6->CNT = 0;
        TIM6->SR &= ~TIM_SR_UIF;
        TIM6->CR1 |= TIM_CR1_CEN;
    }
}

uint16_t ADC_ReadChannel(uint8_t channel)
{
    /* EMA фильтр (alpha=1/2, Q16): окно оседания ~0.4 с при 5 Гц */
    static uint32_t ema[2] = {0}; /* Q16: индекс 0 = ch0, 1 = ch5 */
    static uint8_t ema_init[2] = {0};

    uint32_t sum = 0;
    uint8_t valid_count = 0;
    ADC1->SQR3 = channel;

    {
        uint32_t iter_tick = HAL_GetTick();
        ADC1->CR2 |= ADC_CR2_SWSTART;
        while (!(ADC1->SR & ADC_SR_EOC))
            if (HAL_GetTick() - iter_tick >= 5)
                break;
        (void)ADC1->DR;
        ADC1->SR = 0;
    }

    for (uint8_t i = 0; i < 60; i++) {
        uint32_t iter_tick = HAL_GetTick();
        ADC1->CR2 |= ADC_CR2_SWSTART;
        uint8_t timeout = 0;
        while (!(ADC1->SR & ADC_SR_EOC)) {
            if (HAL_GetTick() - iter_tick >= 5) {
                timeout = 1;
                break;
            }
        }
        if (!timeout) {
            sum += ADC1->DR;
            valid_count++;
        } else {
            (void)ADC1->DR;
        }
        ADC1->SR = 0;
    }

    uint16_t raw_avg = (valid_count > 0) ? (uint16_t)(sum / valid_count) : 0;
    uint16_t mv_value = ((uint32_t)raw_avg * vdda) >> 12;
    /*
        if (channel == 0 || channel == 5) {  U_cur_mes и U_mes
    uint8_t fi = (channel == 0) ? 0 : 1;
    if (!ema_init[fi]) {
        ema[fi] = (uint32_t)mv_value << 16;
        ema_init[fi] = 1;
    } else {
         alpha = 1/2: EMA = EMA/2 + new/2
        ema[fi] = (ema[fi] >> 1) + ((uint32_t)mv_value << 15);
    }
    return (uint16_t)(ema[fi] >> 16);
}
*/

    return mv_value;
}
void MeasureVref(void)
{
    uint32_t sum = 0;

    ADC1->DR;
    ADC1->SR = 0;
    ADC1->SQR3 = 17;

    ADC1->CR2 |= ADC_CR2_SWSTART;
    while (!(ADC1->SR & ADC_SR_EOC))
        ;
    (void)ADC1->DR;
    ADC1->SR = 0;

    for (uint8_t i = 0; i < 8; i++) {
        ADC1->CR2 |= ADC_CR2_SWSTART;
        while (!(ADC1->SR & ADC_SR_EOC))
            ;
        sum += ADC1->DR;
        ADC1->SR = 0;
    }

    uint16_t raw_vrefint = sum / 8;
    vdda = (3300UL * (*(uint16_t *)VREFINT_CAL_ADDR)) / raw_vrefint;
}

void UART4_Transmit(uint8_t *data, uint16_t size)
{
    for (uint16_t i = 0; i < size; i++) {
        UART4->DR = data[i];
        while (!(UART4->SR & USART_SR_TXE))
            ;
    }
    while (!(UART4->SR & USART_SR_TC))
        ;
}

void UART5_Transmit_DMA_Blocking(uint8_t *data, uint16_t size)
{

    while (uart5_tx_dma_busy)
        ;
    DMA1_Stream7->CR &= ~DMA_SxCR_EN;
    while (DMA1_Stream7->CR & DMA_SxCR_EN)
        ;
    DMA1_Stream7->M0AR = (uint32_t)data;
    DMA1_Stream7->NDTR = size;
    DMA1->HIFCR |= DMA_HIFCR_CTCIF7;
    uart5_tx_dma_busy = 1;
    DMA1_Stream7->CR |= DMA_SxCR_EN;
    while (!(DMA1_Stream7->CR & DMA_SxCR_EN))
        ;
}
void UART4_Transmit_DMA_Blocking(uint8_t *data, uint16_t size)
{

    while (uart4_tx_dma_busy)
        ;
    DMA1_Stream4->CR &= ~DMA_SxCR_EN;
    while (DMA1_Stream4->CR & DMA_SxCR_EN)
        ;
    DMA1_Stream4->M0AR = (uint32_t)data;
    DMA1_Stream4->NDTR = size;
    DMA1->HIFCR |= DMA_HIFCR_CTCIF4;
    uart4_tx_dma_busy = 1;
    DMA1_Stream4->CR |= DMA_SxCR_EN;
    while (!(DMA1_Stream4->CR & DMA_SxCR_EN))
        ;
}

void Calibration(void)
{
    static uint16_t u_cur_mes;
    static uint16_t u_mes_kz;
    static uint16_t u_mes;
    if (CHECK_CALIB_IN_PR() && (c_index <= N_SEGMENTS)) {
        if (!NormalOrKZ) {
            u_cur_mes = ADC_ReadChannel(ADC_CH_CURRENT_MES);
            u_mes = ADC_ReadChannel(ADC_CH_VOLTAGE_MES);
            uint16_t calib_value = usRegHoldingBuf[HREG_CALIB_VALUE] == 0 ? 1 : usRegHoldingBuf[HREG_CALIB_VALUE];
            u_cur_mes = u_cur_mes == 0 ? 1 : u_cur_mes;
            c_a[c_index] = (uint16_t)(((uint32_t)usRegInputBuf[IREG_OSCILLOSCOPE_I] << Q11_SHIFT) /
                                      (((uint32_t)vdda * calib_value) >> 12));
            c_b[c_index] = (uint16_t)(((uint32_t)usRegInputBuf[IREG_OSCILLOSCOPE_I] << Q11_SHIFT) / u_cur_mes);

            SET_NormalOrKZ();
            NormalOrKZ = 1;

        } else {
            u_mes_kz = ADC_ReadChannel(ADC_CH_VOLTAGE_MES);

            uint16_t I_osc = usRegInputBuf[IREG_OSCILLOSCOPE_I];
            uint16_t I_kz = usRegHoldingBuf[HREG_CALIB_I_KZ];
            uint16_t U_calib = usRegHoldingBuf[HREG_CALIB_U];

            if (I_kz == 0)
                I_kz = 1;

            // c_d = U_calib / (u_mes - I_osc/I_kz * u_mes_kz)
            uint32_t ratio_q11 = ((uint32_t)I_osc << Q11_SHIFT) / I_kz;
            uint32_t subtract_term = (ratio_q11 * u_mes_kz) >> Q11_SHIFT;

            uint32_t denom;
            if (u_mes > subtract_term)
                denom = u_mes - subtract_term;
            else
                denom = 1;

            c_d[c_index] = (uint16_t)(((uint32_t)U_calib << Q11_SHIFT) / (uint32_t)denom);

            // c_e = (u_mes * c_d - U_calib) / I_osc
            if (I_osc == 0)
                I_osc = 1;

            uint32_t u_mes_times_cd = (uint32_t)u_mes * c_d[c_index];
            uint32_t u_calib_q11 = (uint32_t)U_calib << Q11_SHIFT;

            if (u_mes_times_cd >= u_calib_q11) {
                c_e[c_index] = (uint16_t)((u_mes_times_cd - u_calib_q11) / I_osc);
            } else {
                c_e[c_index] = 0;
            }

            CLR_NormalOrKZ();
            NormalOrKZ = 0;
            usRegHoldingBuf[HREG_CALIB_U] = 0;
            usRegHoldingBuf[HREG_CALIB_I_KZ] = 0;
            usRegHoldingBuf[HREG_CALIB_VALUE] = 0;
            c_index++;
            usRegInputBuf[IREG_CALIB_STEP] = c_index;
            usRegInputBuf[IREG_OSCILLOSCOPE_I] = MIN_I + c_index * ((MAX_I - MIN_I) / N_SEGMENTS);
        }
    }
    if (c_index == N_SEGMENTS + 1 || !CHECK_SET_CALIB_MODE()) {
        NormalOrKZ = 0;
        TIM6->ARR = 9183;
        c_index = 0;
        CLR_CALIB_MODE();
        CLR_CALIB_MODE_IN_PR();
        SET_STANDBY_MODE();
        usRegInputBuf[IREG_OSCILLOSCOPE_I] = CALIB_INITIAL_I;
        usRegHoldingBuf[HREG_CALIB_VALUE] = 0;
        usRegInputBuf[IREG_CALIB_STEP] = 0;
        usRegInputBuf[IREG_CALIB_CA] = 0;
        usRegInputBuf[IREG_CALIB_CB] = 0;
        eeprom_write_coef_pending = 1;
    }
}
void Set_I(uint16_t i)
{
    i_set_cur = i;
    SET_CUR_SETTING();
    // Запуск TIM6
    TIM6->CNT = 0;
    TIM6->SR &= ~TIM_SR_UIF;
    TIM6->CR1 |= TIM_CR1_CEN;
}
void StopChange_I(void)
{
    CLR_CUR_SETTING();
    // Остановка TIM6
    TIM6->CR1 &= ~TIM_CR1_CEN;
    TIM6->CNT = 0;
}
void Change_I(void)
{
    if (!CHECK_HEATER_STATUS())
        return;

    uint16_t U_mes = ADC_ReadChannel(ADC_CH_CURRENT_MES);
    uint16_t I_cur = Calculate_I_from_U(U_mes);
    uint16_t coef_a = Get_c_a_by_I(I_cur);

    uint16_t I_set_cur_local;
    if (CHECK_SET_OPERATING_MODE())
        I_set_cur_local = usRegHoldingBuf[HREG_OPERATING_I];
    else if (CHECK_SET_STANDBY_MODE())
        I_set_cur_local = usRegHoldingBuf[HREG_STANDBY_I];
    else
        I_set_cur_local = usRegHoldingBuf[HREG_STANDBY_I]; // По умолчанию

    uint16_t diff_I = (I_cur > I_set_cur_local) ? (I_cur - I_set_cur_local) : (I_set_cur_local - I_cur);

    if (diff_I < usRegHoldingBuf[HREG_ACCURACY]) {
        StopChange_I();
        return;
    }

    uint16_t delta_U;
    if (diff_I < 500) {
        // Мелкое управление - шаг = точность
        delta_U = (uint16_t)(((uint32_t)usRegHoldingBuf[HREG_ACCURACY] << Q11_SHIFT) / (uint32_t)coef_a);
    } else {
        // Быстрое управление - шаг = скорость / N_TIMERS
        delta_U =
            (uint16_t)(((uint32_t)usRegHoldingBuf[HREG_CURRENT_SPEED] << Q11_SHIFT) / ((uint32_t)N_TIMERS * coef_a));
    }

    uint16_t new_voltage;
    if (I_cur < I_set_cur_local) {
        new_voltage = usRegInputBuf[IREG_U_SET] + delta_U > MAX_DAC_VOLTAGE ? MAX_DAC_VOLTAGE
                                                                            : usRegInputBuf[IREG_U_SET] + delta_U;
    } else
        new_voltage = usRegInputBuf[IREG_U_SET] - delta_U <= 0 ? 0 : usRegInputBuf[IREG_U_SET] - delta_U;

    DAC_SetVoltage(new_voltage);
    usRegInputBuf[IREG_U_SET] = new_voltage;
}
uint16_t Get_c_a_by_I(uint16_t i)
{
    // if (CHECK_CALIB_IN_PR())
    //     return COEF_A_DEFAULT << Q11_SHIFT;

    const uint16_t default_val = (uint16_t)(COEF_A_DEFAULT << Q11_SHIFT);

    if (i <= MIN_I)
        return (c_a[0] != 0) ? c_a[0] : default_val;
    if (i >= MAX_I)
        return (c_a[N_SEGMENTS - 1] != 0) ? c_a[N_SEGMENTS - 1] : default_val;

    uint32_t idx = ((uint32_t)(i - MIN_I) * (uint32_t)N_SEGMENTS) / (MAX_I - MIN_I + 1);
    if (idx >= (uint32_t)N_SEGMENTS)
        idx = N_SEGMENTS - 1;

    return (c_a[idx] == 0) ? default_val : c_a[idx];
}

uint16_t Get_c_b_by_U_mes(uint16_t u)
{
    const uint16_t default_val = (uint16_t)(COEF_B_DEFAULT << Q11_SHIFT);

    if (u <= MIN_U)
        return (c_b[0] != 0) ? c_b[0] : default_val;
    if (u >= MAX_U)
        return (c_b[N_SEGMENTS - 1] != 0) ? c_b[N_SEGMENTS - 1] : default_val;

    uint32_t idx = ((uint32_t)(u - MIN_U) * (uint32_t)N_SEGMENTS) / (MAX_U - MIN_U + 1);
    if (idx >= (uint32_t)N_SEGMENTS)
        idx = N_SEGMENTS - 1;

    return (c_b[idx] == 0) ? default_val : c_b[idx];
}

uint16_t Calculate_I_from_U(uint16_t u_mes)
{
    // // Проход 1: грубая оценка тока через c_b[0] для определения сегмента
    // uint16_t cb0 = (c_b[0] != 0) ? c_b[0] : (uint16_t)(COEF_B_DEFAULT << Q11_SHIFT);
    // uint16_t i_rough = (uint16_t)(((uint32_t)u_mes * cb0 + Q11_HALF) >> Q11_SHIFT);
    // // Проход 2: точный c_b из правильного сегмента по грубому току
    // uint16_t coef_b = Get_c_b_by_I(i_rough);
    uint16_t coef_b = Get_c_b_by_U_mes(u_mes);
    return (uint16_t)(((uint32_t)u_mes * coef_b) >> Q11_SHIFT);
}

uint16_t Get_c_d_by_U(uint16_t u)
{
    if (CHECK_CALIB_IN_PR())
        return COEF_D_DEFAULT << Q11_SHIFT;

    const uint16_t default_val = (uint16_t)(COEF_D_DEFAULT << Q11_SHIFT);

    if (u <= MIN_U)
        return (c_d[0] != 0) ? c_d[0] : default_val;
    if (u >= MAX_U)
        return (c_d[N_SEGMENTS - 1] != 0) ? c_d[N_SEGMENTS - 1] : default_val;
    uint32_t idx = ((uint32_t)(u - MIN_U) * (uint32_t)N_SEGMENTS) / (MAX_U - MIN_U + 1);
    if (idx >= (uint32_t)N_SEGMENTS)
        idx = N_SEGMENTS - 1;

    return (c_d[idx] == 0) ? default_val : c_d[idx];
}

uint16_t Get_c_e_by_I(uint16_t i)
{
    if (CHECK_CALIB_IN_PR())
        return COEF_E_DEFAULT;

    if (i <= MIN_I)
        return c_e[0];
    if (i >= MAX_I)
        return c_e[N_SEGMENTS - 1];

    uint32_t idx = ((uint32_t)(i - MIN_I) * (uint32_t)N_SEGMENTS) / (MAX_I - MIN_I + 1);
    if (idx >= (uint32_t)N_SEGMENTS)
        idx = N_SEGMENTS - 1;

    return c_e[idx];
}

void Update_Input_States(void) {}

void SetOperatingMode(void)
{
    if (CHECK_CALIB_IN_PR()) {
        CLR_CALIB_MODE();
        Calibration(); // Завершить калибровку
    } else if (CHECK_SET_STANDBY_MODE()) {
        CLR_STANDBY_MODE();
    }
    SET_OPERATING_MODE();
}

void SetStandbyMode(void)
{
    if (CHECK_CALIB_IN_PR()) {
        CLR_CALIB_MODE();
        Calibration(); // Завершить калибровку
    } else if (CHECK_SET_OPERATING_MODE()) {
        CLR_OPERATING_MODE();
    }
    SET_STANDBY_MODE();
}

void SetCalibrationMode(void)
{
    if (CHECK_JMPR_STATUS()) {
        CLR_CALIB_MODE();
        return;
    }

    if (CHECK_SET_STANDBY_MODE()) {
        CLR_STANDBY_MODE();
    } else if (CHECK_SET_OPERATING_MODE()) {
        CLR_OPERATING_MODE();
    }

    usRegInputBuf[IREG_OSCILLOSCOPE_I] = CALIB_INITIAL_I;
    TIM6->ARR = 6419; // 10 Гц заместо 7 Гц
    SET_CALIB_MODE_IN_PR();
}

void Coils_ApplyToPins(void)
{
    if (!CHECK_ENABLE_HEATER())
        HEATER_OUT_GPIO->BSRR = (1 << HEATER_OUT_PIN);
    else
        HEATER_OUT_GPIO->BSRR = (1 << (HEATER_OUT_PIN + 16));
}
void HandleModbusRequest(uint8_t *RxBuf)
{
    if (RxBuf[0] == SLAVE_ID) {
        switch (RxBuf[1]) {
            case 0x03:
                readHoldingRegs();
                break;
            case 0x04:
                readInputRegs();
                break;
            case 0x01:
                readCoils();
                break;
            case 0x02:
                readInputs();
                break;
            case 0x06:
                writeSingleReg();
                break;
            case 0x10:
                writeHoldingRegs();
                break;
            case 0x05:
                writeSingleCoil();
                break;
            case 0x0F:
                writeMultiCoils();
                break;
            default:
                modbusException(ILLEGAL_FUNCTION);
                break;
        }
        modbus_req_count++;
        eeprom_write_modbus_req_count_pending = 1;
    }
}

void WriteLog(LogType_t type, uint8_t subtype, uint8_t code)
{
    uint32_t tick = HAL_GetTick();
    uint8_t full_code = type << 6 | subtype << 4 | code;
    uint8_t log[5] = {tick & 0x000000FF, (tick >> 8) & 0xFF, (tick >> 16) & 0xFF, (tick >> 24) & 0xFF, full_code};
    EEPROM_Write(&eeprom, EEPROM_ADDR_LOG_DATA + 5 * log_i, log, 5, 100);
    if (log_i == 22) // 23 записи (0-22), т.к. 119 байт / 5 = 23
        log_i = 0;
    else
        log_i++;
    if (log_count != 255) {
        log_count++;
        EEPROM_Write(&eeprom, EEPROM_ADDR_LOG_COUNT, &log_count, 1, 100);
    }
}

/* USER CODE END 4 */

void Error_Handler(void)
{
    __disable_irq();
    while (1) {
    }
}
